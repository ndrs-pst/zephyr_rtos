## dts/bindings/ethernet/infineon,eth-pdl.yaml
```yaml
# Copyright 2026 Infineon
# SPDX-License-Identifier: Apache-2.0

description: Infineon Ethernet controller

compatible: "infineon,eth-pdl"

include: [ethernet-controller.yaml, pinctrl-device.yaml]

properties:
  reg:
    required: true

  clocks:
    required: true

  clk-dst:
    type: int
    required: true
    description: |
      Peripheral clock destination ID for this ETH instance.
      Maps to an en_clk_dst_t value used by the Infineon PDL to
      connect a peripheral clock divider to this ETH block.

  interrupts:
    required: true

  interrupt-names:
    required: false
```

## dts/bindings/ethernet/mdio/infineon,mdio-pdl.yaml
```yaml
# Copyright 2026 Infineon
# SPDX-License-Identifier: Apache-2.0

description: |
  Infineon PDL MDIO controller.

compatible: "infineon,mdio-pdl"

include: [mdio-controller.yaml, pinctrl-device.yaml]

properties:
  pinctrl-0:
    required: true

  pinctrl-names:
    required: true
```

## dts/bindings/ethernet/microchip,lan8742a.yaml
```yaml
# Copyright (c) 2024 NDR Solution (Thailand) Co., Ltd.
# SPDX-License-Identifier: Apache-2.0

description: Microchip LAN8742A Ethernet PHY device

compatible: "microchip,lan8742a"

include: ethernet-phy.yaml

properties:
  mc,reset-gpio:
    type: phandle-array
    specifier-space: gpio
    description: GPIO connected to PHY reset signal pin. Reset is active low.
  mc,interrupt-gpio:
    type: phandle-array
    specifier-space: gpio
    description: GPIO for interrupt signal indicating PHY state change.
  mc,led1-function-select:
    type: string
    default: "link-activity"
    description: LED1 Function Select
    enum:
      - "link-activity"
      - "#int"
      - "#pme"
      - "link-speed"
  mc,led2-function-select:
    type: string
    default: "link-speed"
    description: LED1 Function Select
    enum:
      - "link-activity"
      - "#int"
      - "#pme"
      - "link-speed"
```

## dts/bindings/ethernet/phy/marvell,88e1510.yaml
```yaml
# SPDX-License-Identifier: Apache-2.0

description: Marvell 88E1510 Gigabit Ethernet PHY

compatible: "marvell,88e1510"

include:
  - name: ethernet-phy-common.yaml
  - name: ethernet-phy-reset-gpios.yaml

on-bus: mdio

properties:
  led0-function-select:
    required: true
    type: string
    default: "link-activity"
    description: LED0 Function Select
    enum:
      - "#0"
      - "#1"
      - "link-speed"
      - "#3"
      - "link-activity"

  led1-function-select:
    required: true
    type: string
    default: "link-speed"
    description: LED1 Function Select
    enum:
      - "#0"
      - "#1"
      - "#2"
      - "#3"
      - "link-activity"
      - "#5"
      - "link-speed"

  default-speeds:
    default:
      - "1000BASE Full-Duplex"
      - "100BASE Full-Duplex"
      - "10BASE Full-Duplex"
```
