## boards/arm/atsamc21_xpro/Kconfig.board
```kconfig
# SAM C21 Xplained Pro Board configuration

# Copyright (c) 2018 Bryan O'Donoghue
# SPDX-License-Identifier: Apache-2.0

config BOARD_ATSAMC21_XPRO
	bool "SAM C21 Xplained Pro"
	depends on SOC_PART_NUMBER_SAMC21J18A
```

## boards/arm/atsamc21_xpro/Kconfig.defconfig
```kconfig
# SAM D21 Xplained Pro board configuration

# Copyright (c) 2018 Bryan O'Donoghue
# SPDX-License-Identifier: Apache-2.0

config BOARD
	default "atsamc21_xpro"
	depends on BOARD_ATSAMC21_XPRO
```

## boards/arm/nucleo_h743zi2/Kconfig.board
```kconfig
# STM32H743ZI Nucleo board configuration

# Copyright (c) 2020 Teslabs Engineering S.L.
# SPDX-License-Identifier: Apache-2.0

config BOARD_NUCLEO_H743ZI2
	bool "Nucleo H743ZI2 Development Board"
	depends on SOC_STM32H743XX
```

## boards/arm/nucleo_h743zi2/nucleo_h743zi2_defconfig
```kconfig
# SPDX-License-Identifier: Apache-2.0

CONFIG_SOC_SERIES_STM32H7X=y
CONFIG_SOC_STM32H743XX=y
# 96MHz system clock (CubeMX Defaults)
CONFIG_SYS_CLOCK_HW_CYCLES_PER_SEC=96000000

# Enable MPU
CONFIG_ARM_MPU=y

# Enable HW stack protection
CONFIG_HW_STACK_PROTECTION=y

# Enable UART
CONFIG_SERIAL=y

# Console
CONFIG_CONSOLE=y
CONFIG_UART_CONSOLE=y

# Enable Pinmux
CONFIG_PINMUX=y

# Enable GPIO
CONFIG_GPIO=y

# Enable clocks
CONFIG_CLOCK_CONTROL=y

# Enable pin controller
CONFIG_PINCTRL=y
```

## boards/infineon/kit_pse84_ai/Kconfig.defconfig
```kconfig
# Copyright (c) 2026 Infineon Technologies AG,
# or an affiliate of Infineon Technologies AG.
#
# SPDX-License-Identifier: Apache-2.0

if BOARD_KIT_PSE84_AI_PSE846GPS2DBZC4A_M55

if WIFI

# Select AIROC part and module
choice AIROC_PART
	default CYW55500
endchoice

choice CYW55500_MODULE
	default CYW55513_MURATA_2FY
endchoice

# Enable L2 Ethernet
config NET_L2_ETHERNET
	default y

# Heap Pool Size
config HEAP_MEM_POOL_ADD_SIZE_BOARD
	int
	default 15000

endif # WIFI

if BT

# Select AIROC part and module
choice AIROC_PART
	default CYW55500
endchoice

choice CYW55500_MODULE
	default CYW55513_MURATA_2FY
endchoice

config MAIN_STACK_SIZE
	default 2048 if BT_HCI

endif # BT

endif # BOARD_KIT_PSE84_AI_PSE846GPS2DBZC4A_M55
```

## drivers/can/Kconfig.sam0
```kconfig
# SAM0 CAN configuration options
# Copyright (c) 2021 Alexander Wachter
# SPDX-License-Identifier: Apache-2.0

DT_COMPAT_ATMEL_SAM0_CAN := atmel,sam0-can

config CAN_SAM0
	bool "Atmel SAM0 CAN driver"
	default $(dt_compat_enabled,$(DT_COMPAT_ATMEL_SAM0_CAN))
	select CAN_MCAN
```

## drivers/ethernet/Kconfig.infineon_pdl
```kconfig
# Copyright (c) 2026 NDR Solution (Thailand) Co., Ltd.
# SPDX-License-Identifier: Apache-2.0

menuconfig ETH_INFINEON_PDL
	bool "Infineon PDL Ethernet driver"
	default y
	depends on DT_HAS_INFINEON_ETH_PDL_ENABLED
	select USE_INFINEON_ETHIF
	select MDIO
	help
	  Enable Infineon PDL Ethernet driver for PSE84 devices.
```

## drivers/ethernet/mdio/Kconfig.infineon
```kconfig
# Copyright 2026 NDR Solution (Thailand) Co., Ltd.
# SPDX-License-Identifier: Apache-2.0

config MDIO_INFINEON_PDL
	bool "Infineon PDL MDIO driver"
	default y
	depends on DT_HAS_INFINEON_MDIO_PDL_ENABLED
```

## drivers/flash/Kconfig.s32k3
```kconfig
# Copyright (c) 2025 NDR Solution (Thailand)
#
# SPDX-License-Identifier: Apache-2.0

config SOC_FLASH_S32K3
    bool "NXP S32K3 C40 flash driver"
    default y
    depends on DT_HAS_NXP_S32K3_C40_ENABLED
    select FLASH_HAS_DRIVER_ENABLED
    select FLASH_HAS_PAGE_LAYOUT
    help
      Enable NXP S32K3 C40 internal flash driver
```

## drivers/fram/Kconfig
```kconfig
# FRAM driver configuration options

# Copyright (c) 2019 Vestas Wind Systems A/S
# Copyright (c) 2023 NDR Solution (Thailand) Co., Ltd.
# SPDX-License-Identifier: Apache-2.0

menuconfig FRAM
	bool "FRAM hardware support"
	help
	  Enable support for FRAM hardware.

if FRAM

module = FRAM
module-str = fram
source "subsys/logging/Kconfig.template.log_config"

config FRAM_INIT_PRIORITY
	int "FRAM init priority"
	default KERNEL_INIT_PRIORITY_DEVICE
	help
	  FRAM driver device initialization priority.

config FRAM_SHELL
	bool "FRAM shell"
	default n
	depends on SHELL
	help
	  Enable the FRAM shell with FRAM related commands.

config FRAM_SHELL_BUFFER_SIZE
	int "FRAM shell buffer size"
	default 256
	depends on FRAM_SHELL
	help
	  Size of the buffer used for FRAM read/write commands in
	  the FRAM shell.

config FRAM_CY15X
	bool
    default y
	help
	  Enable support for Infineon CY15X (and compatible) I2C/SPI
	  FRAMs.

config FRAM_CY15XJ
	bool "Infineon CY15J (and compatible) I2C FRAM support"
	default y
	depends on DT_HAS_INFINEON_CY15XJ_ENABLED
	select I2C
	select FRAM_CY15X
	help
	  Enable support for Infineon CY15J (and compatible) I2C FRAMs.

config FRAM_CY15XQ
	bool "Infineon CY15Q (and compatible) SPI FRAM support"
	default y
	depends on DT_HAS_INFINEON_CY15XQ_ENABLED
	select SPI
	select FRAM_CY15X
	help
	  Enable support for Infineon CY15Q (and compatible) SPI FRAMs.

endif # FRAM
```

## drivers/hwinfo/Kconfig.nxp_s32
```kconfig
# Copyright (c) 2026 NDR Solution (Thailand) Co., Ltd.
# SPDX-License-Identifier: Apache-2.0

config HWINFO_NXP_S32
	bool "NXP S32 hwinfo driver"
	default y
	depends on SOC_SERIES_S32K3
	select HWINFO_HAS_DRIVER
	help
	  Enable NXP S32K3 hwinfo driver.
	  Provides reset cause via MC_RGM (DES + FES registers) and device
	  identification via SIUL2 MIDR1-MIDR4 registers.
	  Note: S32K358 has no unique silicon serial number; device ID reflects
	  the MCU part/variant only.
```

## drivers/mdio/Kconfig.stm32
```kconfig
# Copyright (c) 2024 NDR Solution (Thailand) Co., Ltd.
# SPDX-License-Identifier: Apache-2.0

config MDIO_STM32
	bool "STM32 Ethernet MDIO driver"
	depends on ETH_STM32_HAL
	default n
	help
	  Enable STM32 MCU Family MDIO driver.
```

## drivers/rtc/Kconfig.pca2131
```kconfig
# NXP PCA2131 RTC
#
# Based on the PCF8523 RTC driver options.

# SPDX-License-Identifier: Apache-2.0

config RTC_PCA2131
	bool "NXP PCA2131 RTC driver"
	default y
	depends on DT_HAS_NXP_PCA2131_ENABLED
	select I2C
	help
	  Enable the NXP PCA2131 RTC driver.

if RTC_PCA2131

if RTC_ALARM || RTC_UPDATE

config RTC_PCA2131_THREAD_STACK_SIZE
	int "Stack size for the PCA2131 interrupt thread"
	default 512
	help
	  Size of the stack used for the thread handling interrupts and dispatching callbacks.

config RTC_PCA2131_THREAD_PRIO
	int "Priority for the PCA2131 interrupt thread"
	default 0
	help
	  Priority level for the thread handling interrupts and dispatching callbacks.

endif # RTC_ALARM || RTC_UPDATE

endif # RTC_PCA2131
```

## drivers/rtc/Kconfig.sam0
```kconfig
# Copyright (c) 2023 Bjarki Arge Andreasen
# Copyright (c) 2023 NDR Solution (Thailand) Co., Ltd.
# SPDX-License-Identifier: Apache-2.0

config RTC_ATMEL_SAM0
	bool "Atmel SAM0 RTC driver"
	default y
	depends on DT_HAS_ATMEL_SAM0_RTC_ENABLED
	help
	  Atmel Real-Time Clock (RTC) driver used on SAM0 SoC series.
```

## drivers/sdhc/Kconfig.stm32
```kconfig
# Copyright (c) 2024 STMicroelectronics
# SPDX-License-Identifier: Apache-2.0

config SDHC_STM32
	bool "STM32 SDHC Driver"
	default y
	depends on DT_HAS_ST_STM32_SDHC_ENABLED
	select SDHC_SUPPORTS_NATIVE_MODE
	select USE_STM32_LL_SDMMC
	select PINCTRL
	help
	  Enables the STM32 SD Host controller driver

if SDHC_STM32

# STM32 DMA needs 32 bit aligned buffers
config SDHC_BUFFER_ALIGNMENT
	default 4

config SDHC_STM32_HWFC
	bool "STM32 SDMMC Hardware Flow control"
	depends on SOC_SERIES_STM32H5X || \
		   SOC_SERIES_STM32H7X || \
		   SOC_SERIES_STM32F7X || \
		   SOC_SERIES_STM32L4X || \
		   SOC_SERIES_STM32L5X
	help
	  Enable SDMMC Hardware Flow Control to avoid FIFO underrun (TX mode) and
	  overrun (RX mode) errors.

endif
```

## drivers/sdhc/Kconfig.stm32_v2
```kconfig
# Copyright (c) 2025 STMicroelectronics
# SPDX-License-Identifier: Apache-2.0

config SDHC_STM32_V2
	bool "STM32 SDHC Driver V2"
	default y
	depends on DT_HAS_ST_STM32_SDHC_V2_ENABLED
	select SDHC_SUPPORTS_NATIVE_MODE
	select USE_STM32_LL_SDMMC
	select PINCTRL
	help
	  Enables the STM32 SD Host controller driver

if SDHC_STM32_V2

# STM32 DMA needs 32 bit aligned buffers
config SDHC_BUFFER_ALIGNMENT
	default 4

config SDHC_STM32_HWFC_V2
	bool "STM32 SDMMC Hardware Flow control"
	depends on SOC_SERIES_STM32H5X || \
		   SOC_SERIES_STM32H7X || \
		   SOC_SERIES_STM32F7X || \
		   SOC_SERIES_STM32L4X || \
		   SOC_SERIES_STM32L5X
	help
	  Enable SDMMC Hardware Flow Control to avoid FIFO underrun (TX mode) and
	  overrun (RX mode) errors.

endif
```

## drivers/usb/udc/Kconfig.stm32
```kconfig
# Copyright (c) 2023 Linaro Limited
# SPDX-License-Identifier: Apache-2.0

config UDC_STM32
	bool "STM32 USB device controller driver"
	depends on DT_HAS_ST_STM32_OTGFS_ENABLED \
		|| DT_HAS_ST_STM32_OTGHS_ENABLED \
		|| DT_HAS_ST_STM32_USB_ENABLED
	select USE_STM32_LL_USB
	select USE_STM32_HAL_PCD
	select USE_STM32_HAL_PCD_EX
	select PINCTRL
	default y
	help
	  STM32 USB device controller driver.

config UDC_STM32_CLOCK_CHECK
	bool "Runtime USB 48MHz clock check"
	depends on UDC_STM32
	default y if !(SOC_SERIES_STM32F1X || SOC_SERIES_STM32F3X || SOC_SERIES_STM32U5X)
	help
	  Enable USB clock 48MHz configuration runtime check.
	  In specific cases, this check might provide wrong verdict and should
	  be disabled.
```

## dts/bindings/bms/bgw/nxp,mc33665a.yaml
```yaml
# Copyright (c) 2025 NDR Solution (Thailand) Co., Ltd.
# SPDX-License-Identifier: Apache-2.0

description: MC33665A Battery management communication gateway

compatible: "nxp,mc33665a"

include: [spi-device.yaml]

properties:
    int-gpios:
      type: phandle-array
      required: true
      description: |
        Interrupt pin.

        This pin signals active low when produced by the controller. The
        property value should ensure the flags properly describe the signal
        that is presented to the driver.
    reg:
      type: array
      required: true
```

## dts/bindings/bms/sps/nxp,mc33hb2000.yaml
```yaml
# Copyright (c) 2026 NDR Solution (Thailand) Co., Ltd.
# SPDX-License-Identifier: Apache-2.0

description: MC33HB2000 H-Bridge, SPI programmable

compatible: "nxp,mc33hb2000"

include: [spi-device.yaml]

properties:
  int-gpios:
    type: phandle-array
    required: true
    description: |
      Interrupt pin.

      This pin signals active low when produced by the controller. The
      property value should ensure the flags properly describe the signal
      that is presented to the driver.
  reg:
    type: array
    required: true

  pwms:
    type: phandle-array
    description: |
      PWM channels for IN1 (index 0) and IN2 (index 1).
      Index 0: IN1 — forward drive (primary)
      Index 1: IN2 — feedback / secondary
      Required when using PWM-mode contactor control (no EN/DIS GPIO).
```

## dts/bindings/bms/sps/nxp,mc33xs2410.yaml
```yaml
# Copyright (c) 2026 NDR Solution (Thailand) Co., Ltd.
# SPDX-License-Identifier: Apache-2.0

description: MC33XS2410 Quad high-side switch

compatible: "nxp,mc33xs2410"

include: [spi-device.yaml]

properties:
    int-gpios:
      type: phandle-array
      required: true
      description: |
        Interrupt pin.

        This pin signals active low when produced by the controller. The
        property value should ensure the flags properly describe the signal
        that is presented to the driver.
    rst-gpios:
      type: phandle-array
      required: true
      description: |
        Reset pin.

        This pin is used to reset the MC33XS2410 device.
    in1-gpios:
      type: phandle-array
      required: false
      description: |
        Input 1 control pin.
    in2-gpios:
      type: phandle-array
      required: false
      description: |
        Input 2 control pin.
    in3-gpios:
      type: phandle-array
      required: false
      description: |
        Input 3 control pin.
    in4-gpios:
      type: phandle-array
      required: false
      description: |
        Input 4 control pin.
    lhm-gpios:
      type: phandle-array
      required: false
      description: |
        LHM (Load High to Medium) control pin.
    reg:
      type: array
      required: true
```

## dts/bindings/dma/st,stm32-mdma.yaml
```yaml
# Copyright (c) 2023 Jeroen van Dooren <jeroen.van.dooren@nobleo.nl>
# Copyright (c) 2024 NDR Solution (Thailand) Co., Ltd.
# SPDX-License-Identifier: Apache-2.0

description: |
  STM32 MDMA controller

  The master direct memory access (MDMA) is used in order to provide high-speed 
  data transfer between memory and memory, or between peripherals and memory.
  The MDMA works in conjunction with the standard DMA controllers (DMA1 or DMA2). 
  It offers up to 16 channels, each dedicated to manage memory access requests from one of 
  the DMA stream memory buffer or other peripherals (with integrated FIFO).
  channel: a phandle to the ADMA controller plus the following four integer cells:
    1. channel: the channel from 0 to (<dma-channels> - 1).
    2. slot: DMA periph request ID, which is written in the TSEL[5:0] bits of the MDMA_CxTBR
    the slot is a value between <0> .. (<dma-requests> - 1).
    3. channel-config: A 32bit mask specifying the DMA channel configuration
    which is device dependent. See stm32_dma.h:
      -bit 0-1: MDMA_CxTCR.SINC[1:0]: Source increment mode
        0x0: Source address pointer is fixed
        0x2: Source address pointer is incremented after each data transfer
        0x3: Source address pointer is decremented after each data transfer
      -bit 2-3: MDMA_CxTCR.DINC[1:0]: Destination increment mode
        0x0: Destination address pointer is fixed
        0x2: Destination address pointer is incremented after each data transfer
        0x3: Destination address pointer is decremented after each data transfer
      -bit 4-5 : Reserved
      -bit 6-7 : Direction (see dma.h)
        0x0: STM32_DMA_MEMORY_TO_MEMORY: MEM to MEM
        0x1: STM32_DMA_MEMORY_TO_PERIPH: MEM to PERIPH
        0x2: STM32_DMA_PERIPH_TO_MEMORY: PERIPH to MEM
        0x3: reserved for PERIPH to PERIPH
      -bit 9 : Peripheral Increment Address
        0x0: STM32_DMA_PERIPH_NO_INC: no address increment between transfers
        0x1: STM32_DMA_PERIPH_INC: increment address between transfers
      -bit 10 : Memory Increment Address
        0x0: STM32_DMA_MEM_NO_INC: no address increment between transfers
        0x1: STM32_DMA_MEM_INC: increment address between transfers
      -bit 11-12 : Peripheral data size
        0x0: STM32_DMA_PERIPH_8BITS: Byte (8 bits)
        0x1: STM32_DMA_PERIPH_16BITS: Half-word (16 bits)
        0x2: STM32_DMA_PERIPH_32BITS: Word (32 bits)
        0x3: reserved
      -bit 13-14 : Memory data size
        0x0: STM32_DMA_MEM_8BITS: Byte (8 bits)
        0x1: STM32_DMA_MEM_16BITS: Half-word (16 bits)
        0x2: STM32_DMA_MEM_32BITS: Word (32 bits)
        0x3: reserved
      -bit 15: Reserved
      -bit 16-17 : Priority level
        0x0: STM32_DMA_PRIORITY_LOW: low
        0x1: STM32_DMA_PRIORITY_MEDIUM: medium
        0x2: STM32_DMA_PRIORITY_HIGH: high
        0x3: STM32_DMA_PRIORITY_VERY_HIGH: very high

    examples for stm32h7
     mdma1: dma-controller@52000000 {
         compatible = "st,stm32-mdma";
         ...
         st,mem2mem;
         dma-requests = <16>;
         status = "disabled";
        };

compatible: "st,stm32-mdma"

include: dma-controller.yaml

properties:
  reg:
    required: true

  interrupts:
    required: true

  "#dma-cells":
    const: 3

# Parameter syntax of stm32 follows the dma client dts syntax
# in the Linux kernel declared in
# https://git.kernel.org/pub/scm/linux/kernel/git/devicetree/devicetree-rebasing.git/plain/Bindings/dma/st,stm32-dma.yaml

dma-cells:
  - channel
  - slot
  - channel-config
```
