## dts/bindings/ethernet/phy/microchip,lan8710ai.yaml
```yaml
# Copyright (c) 2026
# SPDX-License-Identifier: Apache-2.0

description: Microchip LAN8710AI Single Port Ethernet PHY

compatible: "microchip,lan8710ai"

include:
  - name: ethernet-phy-common.yaml
  - name: ethernet-phy-reset-gpios.yaml

on-bus: mdio

properties:
  reg:
    required: true
    description: |
      5-bit MDIO PHY address for the attached PHY.

  led1-function-select:
    type: string
    default: "link-activity"
    description: LED1 Function Select
    enum:
      - "link-activity"
      - "#int"
      - "#pme"
      - "link-speed"

  led2-function-select:
    type: string
    default: "link-speed"
    description: LED2 Function Select
    enum:
      - "link-speed"
      - "#int"
      - "#pme"
      - "link-activity"

  default-speeds:
    default: ["10BASE Half-Duplex", "10BASE Full-Duplex", "100BASE Half-Duplex",
              "100BASE Full-Duplex"]
```

## dts/bindings/flash_controller/nxp,s32k3-c40.yaml
```yaml
description: NXP S32K3 C40 Flash Controller

compatible: "nxp,s32k3-c40"

include: flash-controller.yaml

properties:
  reg:
    required: true
    
  write-block-size:
    type: int
    required: true
    description: Flash write block size in bytes (typically 8 for S32K3)
    
  erase-block-size:
    type: int
    required: true
    description: Flash erase block size (sector size, typically 8KB for S32K3)
```

## dts/bindings/gpio/gpio-pinnames.yaml
```yaml
# Copyright (c) 2021, PST1981
# SPDX-License-Identifier: Apache-2.0

description: GPIO PinNames parent node

compatible: "gpio-pinnames"

include:
    - name: base.yaml
      property-allowlist: [label]

properties:
    label:
      description: |
        Human readable string describing the device and used to set the device
        name. It can be passed as argument to device_get_binding() to retrieve
        the device. If this property is omitted, then the device name is set
        from the node full name.

child-binding:
    description: GPIO PinNames child node
    properties:
       gpios:
          type: phandle-array
          required: true
       label:
          required: false
          type: string
          description: |
            Human readable string describing the pin name. It can be used by an
            application to identify this PIN or to retrieve its number/index
            (i.e. child node number) on the parent device.
```

## dts/bindings/mdio/st,stm32-mdio.yaml
```yaml
# Copyright (c) 2024 NDR Solution (Thailand) Co., Ltd.
# SPDX-License-Identifier: Apache-2.0

description: STM32 MDIO Driver node

compatible: "st,stm32-mdio"

include:
  - name: mdio-controller.yaml
  - name: pinctrl-device.yaml
```

## dts/bindings/mtd/fram-base.yaml
```yaml
# Copyright (c) 2019 Vestas Wind Systems A/S
# Copyright (c) 2023 NDR Solution (Thailand) Co., Ltd.
# SPDX-License-Identifier: Apache-2.0

# Common fields for FRAM devices

include: base.yaml

properties:
  size:
    type: int
    description: Total FRAM size in bytes
  read-only:
    type: boolean
    description: Disable writes to the FRAM
```

## dts/bindings/mtd/infineon,cy15x-base.yaml
```yaml
# Copyright (c) 2019 Vestas Wind Systems A/S
# Copyright (c) 2023 NDR Solution (Thailand) Co., Ltd.
# SPDX-License-Identifier: Apache-2.0

# Common fields for Infineon (CY15BxxxQ) FRAM

include: fram-base.yaml

properties:
  size:
    required: true
  address-width:
    type: int
    required: true
    description: FRAM address width in bits
  timeout:
    type: int
    required: true
    description: FRAM write cycle timeout in milliseconds
  wp-gpios:
    type: phandle-array
    description: |
      GPIO to which the write-protect pin of the chip is connected.

      The device will interpret this signal as active-low.
```

## dts/bindings/mtd/infineon,cy15xq.yaml
```yaml
# Copyright (c) 2019 Vestas Wind Systems A/S
# Copyright (c) 2023 NDR Solution (Thailand) Co., Ltd.
# SPDX-License-Identifier: Apache-2.0

description: Infineon (CY15BxxxQ) SPI FRAM

compatible: "infineon,cy15xq"

include: ["infineon,cy15x-base.yaml", spi-device.yaml]

properties:
  rdid-supported:
    type: boolean
    description: |
      Set if the device supports the RDID (0x9F) command. When present,
      the driver reads the device ID at init and logs it. Omit for
      variants that do not implement RDID.
```

## dts/bindings/pmic/infineon,tlf30682qvs01.yaml
```yaml
# Copyright (c) 2026 NDR Solution (Thailand) Co., Ltd.
# SPDX-License-Identifier: Apache-2.0

description: OPTIREG™ PMIC TLF30682QVS01 Power management IC

compatible: "infineon,tlf30682qvs01"

include: [spi-device.yaml]

properties:
  int-gpios:
    type: phandle-array
    required: true
    description: |
      Interrupt pin.

      This pin signals active low when produced by the controller. The
      property value should ensure the flags properly describe the signal
      that is presented to the driver.
  wdi-gpios:
    type: phandle-array
    description: |
      Watchdog input, trigger pin.

      The host MCU periodically toggles this output to service the PMIC
      watchdog timer. Missing or invalid transitions on this signal may
      cause the PMIC to trigger a watchdog reset or other recovery action.
```

## dts/bindings/rtc/nxp,pca2131.yaml
```yaml
# Copyright (c) 2026 NDR Solution (Thailand) Co., Ltd.
# SPDX-License-Identifier: Apache-2.0

description: NXP PCA2131 RTC with integrated TCXO

compatible: "nxp,pca2131"

include:
  - name: rtc-device.yaml
  - name: i2c-device.yaml
  - name: pm.yaml
    property-allowlist:
      - wakeup-source

properties:

  clkout-frequency:
    type: int
    default: 32768
    enum:
      - 32768
      - 16384
      - 8192
      - 4096
      - 2048
      - 1024
      - 1
      - 0
    description: |
      Frequency of the CLKOUT signal in Hertz (Hz). Default is 32768 Hz. Set to 0 to
      disable the CLKOUT signal (High-Z). The COF field maps: 0=32768, 1=16384, 2=8192,
      3=4096, 4=2048, 5=1024, 6=1Hz, 7=High-Z.

  battery-switch-over:
    type: string
    required: true
    enum:
      - standard
      - direct
      - disabled
    description: |
      Battery switch-over function selection:
        - standard: The power failure condition happens when VDD < VBAT and VDD < Vth(sw)bat
        - direct: The power failure condition happens when VDD < VBAT
        - disabled: Battery switch-over disabled - only one power supply (VDD)

  int1-gpios:
    type: phandle-array
    description: |
      GPIO connected to the PCA2131 INT1 interrupt output. This signal is open-drain, active low.
```

## dts/bindings/sbc/nxp,fs26.yaml
```yaml
# Copyright (c) 2025 NDR Solution (Thailand) Co., Ltd.
# SPDX-License-Identifier: Apache-2.0

description: FS26 Safety system basis chip with low power for ASIL D/ASIL B

compatible: "nxp,fs26"

include: [spi-device.yaml]

properties:
    int-gpios:
      type: phandle-array
      required: true
      description: |
        Interrupt pin.

        This pin signals active low when produced by the controller. The
        property value should ensure the flags properly describe the signal
        that is presented to the driver.
    reg:
      type: array
      required: true
```

## dts/bindings/sbc/nxp,mc33903.yaml
```yaml
# Copyright (c) 2019 Karsten Koenig
# SPDX-License-Identifier: Apache-2.0

description: MC33903 SPI CAN controller

compatible: "nxp,mc33903"

include: [spi-device.yaml]

properties:
    int-gpios:
      type: phandle-array
      required: true
      description: |
        Interrupt pin.

        This pin signals active low when produced by the controller. The
        property value should ensure the flags properly describe the signal
        that is presented to the driver.
    reg:
      type: array
      required: true
```

## dts/bindings/sdhc/st,stm32-sdhc.yaml
```yaml
# Copyright (c) 2024 STMicroelectronics
#
# SPDX-License-Identifier: Apache-2.0

description: STM32 SDMMC controller

compatible: "st,stm32-sdhc"

include: [sdhc.yaml, pinctrl-device.yaml]

properties:
  clocks:
    required: true

  reg:
    required: true

  pinctrl-0:
    required: true

  pinctrl-names:
    required: true
```

## dts/bindings/sensor/st,stpm3x-spi.yaml
```yaml
# Copyright (c) 2019 STMicroelectronics
# SPDX-License-Identifier: Apache-2.0

description: |
    STMicroelectronics STPM3X Energy Measurement IC accessed through SPI bus

compatible: "st,stpm3x-spi"

include: spi-device.yaml

properties:
    irq-gpios:
      type: phandle-array
      required: false
      description: DRDY pin

        This pin defaults to active high when produced by the sensor.
        The property value should ensure the flags properly describe
        the signal that is presented to the driver.
```

## dts/bindings/serial/arm,pl011.yaml
```yaml
description: ARM PL011 UART

compatible: "arm,pl011"

include: [uart-controller.yaml, pinctrl-device.yaml, reset-device.yaml]

properties:
  reg:
    required: true

  fifo-disable:
    type: boolean
    description: Disable the UART FIFO

  dmas:
    type: phandle-array
    description: |
      Optional DMA channel specifiers for TX and RX async operation.
      Must contain entries named "tx" and "rx" as declared by dma-names.

  dma-names:
    type: string-array
    description: |
      Names of the DMA channels referenced by the dmas property.
      Must be "tx" and "rx".
```

## dts/bindings/spi/infineon,spi.yaml
```yaml
# Copyright (c) 2022 Cypress Semiconductor Corporation (an Infineon company) or
# an affiliate of Cypress Semiconductor Corporation
#
# SPDX-License-Identifier: Apache-2.0

description: Infineon CAT1 SPI

compatible: "infineon,spi"

include: [spi-controller.yaml, pinctrl-device.yaml, "infineon,scb.yaml"]

properties:
  reg:
    required: true

  interrupts:
    required: true

  pinctrl-0:
    required: true

  ss-setup-delay:
    type: boolean
    description: |
      Adds 1 extra SPI clock cycle between SS assertion and the first SCK edge
      (1.75 vs default 0.75 cycles). Requires Motorola sub-mode,
      SCLK_CONTINUOUS=0, and oversample > 2. SCB v2+ / PSE84 (EDGE) only.

  ss-hold-delay:
    type: boolean
    description: |
      Adds 1 extra SPI clock cycle between the last SCK edge and SS deassertion
      (1.75 vs default 0.75 cycles). Same hardware requirements as ss-setup-delay.

  ss-inter-frame-delay:
    type: boolean
    description: |
      Adds 1 extra SPI clock cycle inter-frame delay between SS deassertion and
      the next assertion (2.5 vs default 1.5 cycles). Same hardware requirements.
```

## dts/bindings/spi/nxp,lpspi.yaml
```yaml
# Copyright (c) 2018,2023 NXP
# SPDX-License-Identifier: Apache-2.0

description: NXP LPSPI controller

compatible: "nxp,lpspi"

include: ["spi-controller.yaml", "pinctrl-device.yaml"]

properties:
  reg:
    required: true

  clocks:
    required: true

  pcs-sck-delay:
    type: int
    description: |
      Delay in nanoseconds from the chip select assert to the first clock
      edge.
      If not set, the minimum supported delay is used.

  sck-pcs-delay:
    type: int
    description: |
      Delay in nanoseconds from the last clock edge to the chip select
      deassert.
      If not set, the minimum supported delay is used.

  transfer-delay:
    type: int
    description: |
      Delay in nanoseconds between last SCK edge of a transfer word and the
      first SCK edge of the next transfer word.
      If not set, the minimum supported delay is used.

  data-pin-config:
    type: string
    enum:
      - "sdi-in,sdo-out"
      - "sdi-in,sdi-out"
      - "sdo-in,sdo-out"
      - "sdo-in,sdi-out"
    default: "sdi-in,sdo-out"
    description: |
      Configures which pins (SDO and SDI) are used for input and output data
      during single bit transfers.

  tristate-output:
    type: boolean
    description:
      Configures whether or not the output data is tristated between accesses
      (when PCS is negated). If set, the output will be tristated when PCS is negated,
      otherwise the output line retains the last value when PCS is negated.

  rx-fifo-size:
    type: int
    required: true
    description: |
      Max number of words in the RX fifo on this instance of the LPSPI.

  tx-fifo-size:
    type: int
    required: true
    description: |
      Max number of words in the TX/Command fifo on this instance of the LPSPI.

  dma-source-data-size:
    type: int
    description: |
      Default source data width in bytes for DMA transfers.
      Specifies the size of each element transferred from source.
      Common values: 1 (byte), 2 (word), 4 (dword), 8 (qword)

  dma-dest-data-size:
    type: int
    description: |
      Default destination data width in bytes for DMA transfers.
      Specifies the size of each element transferred to destination.
      Common values: 1 (byte), 2 (word), 4 (dword), 8 (qword)

  dma-source-burst-length:
    type: int
    description: |
      Default source burst length in bytes for DMA transfers.
      Number of bytes transferred in a single burst from source.

  dma-dest-burst-length:
    type: int
    description: |
      Default destination burst length in bytes for DMA transfers.
      Number of bytes transferred in a single burst to destination.
```

## soc/arm/atmel_sam0/common/Kconfig.samc2x
```kconfig
# SPDX-License-Identifier: Apache-2.0

if SOC_SERIES_SAMC21

config SOC_ATMEL_SAMC_XOSC32K
	bool "External 32 kHz crystal oscillator"
	help
	  Say y to enable the external 32 kHZ crystal oscillator at
	  startup.  This can then be selected as the main clock source
	  for the SOC.

config SOC_ATMEL_SAMC_XOSC
	bool "External crystal oscillator"
	help
	  Say y to enable the external crystal oscillator at startup.

choice
	prompt "Main clock source"
	help
	  Selects the clock that the main clocks, such as the CPU
	  clock and AHB clock, will be derived from.

config SOC_ATMEL_SAMC_XOSC32K_AS_MAIN
	depends on SOC_ATMEL_SAMC_XOSC32K
	bool "XOSC32K"

config SOC_ATMEL_SAMC_XOSC_AS_MAIN
	depends on SOC_ATMEL_SAMC_XOSC
	bool "XOSC"

config SOC_ATMEL_SAMC_OSC8M_AS_MAIN
	bool "OSC8M"

endchoice

endif # SOC_SERIES_SAMC21
```

## soc/arm/atmel_sam0/samc21/Kconfig.defconfig.series
```kconfig
# Atmel SAMC MCU series configuration options

# Copyright (c) 2017 Google LLC.
# SPDX-License-Identifier: Apache-2.0

if SOC_SERIES_SAMC21

config SOC_SERIES
	default "samc21"

config SOC_PART_NUMBER
	default "samc21e15a" if SOC_PART_NUMBER_SAMC21E15A
	default "samc21e16a" if SOC_PART_NUMBER_SAMC21E16A
	default "samc21e17a" if SOC_PART_NUMBER_SAMC21E17A
	default "samc21e18a" if SOC_PART_NUMBER_SAMC21E18A
	default "samc21g15a" if SOC_PART_NUMBER_SAMC21G15A
	default "samc21g16a" if SOC_PART_NUMBER_SAMC21G16A
	default "samc21g17a" if SOC_PART_NUMBER_SAMC21G17A
	default "samc21g18a" if SOC_PART_NUMBER_SAMC21G18A
	default "samc21j15a" if SOC_PART_NUMBER_SAMC21J15A
	default "samc21j16a" if SOC_PART_NUMBER_SAMC21J16A
	default "samc21j17a" if SOC_PART_NUMBER_SAMC21J17A
	default "samc21j18a" if SOC_PART_NUMBER_SAMC21J18A

config NUM_IRQS
	default 28

config SYS_CLOCK_HW_CYCLES_PER_SEC
	default 48000000

endif # SOC_SERIES_SAMC21
```
