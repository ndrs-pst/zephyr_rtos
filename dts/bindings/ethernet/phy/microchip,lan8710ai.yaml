## soc/arm/atmel_sam0/samc21/Kconfig.soc
```kconfig
# Atmel SAMC MCU series

# Copyright (c) 2017 Google LLC.
# SPDX-License-Identifier: Apache-2.0

choice
	prompt "Atmel SAMC21 MCU Selection"
	depends on SOC_SERIES_SAMC21

config SOC_PART_NUMBER_SAMC21E15A
	bool "SAMC21E15A"

config SOC_PART_NUMBER_SAMC21E16A
	bool "SAMC21E16A"

config SOC_PART_NUMBER_SAMC21E17A
	bool "SAMC21E17A"

config SOC_PART_NUMBER_SAMC21E18A
	bool "SAMC21E18A"

config SOC_PART_NUMBER_SAMC21G15A
	bool "SAMC21G15A"

config SOC_PART_NUMBER_SAMC21G16A
	bool "SAMC21G16A"

config SOC_PART_NUMBER_SAMC21G17A
	bool "SAMC21G17A"

config SOC_PART_NUMBER_SAMC21G18A
	bool "SAMC21G18A"

config SOC_PART_NUMBER_SAMC21J15A
	bool "SAMC21J15A"

config SOC_PART_NUMBER_SAMC21J16A
	bool "SAMC21J16A"

config SOC_PART_NUMBER_SAMC21J17A
	bool "SAMC21J17A"

config SOC_PART_NUMBER_SAMC21J18A
	bool "SAMC21J18A"

endchoice
```

## soc/atmel/sam0/common/Kconfig.samc2x
```kconfig
# Copyright (c) 2022 Kamil Serwus
# SPDX-License-Identifier: Apache-2.0

if SOC_SERIES_SAMC20 || SOC_SERIES_SAMC21

config SOC_ATMEL_SAMC_XOSC32K
	bool "External 32 kHz crystal oscillator"
	help
	  Say y to enable the external 32 kHZ crystal oscillator at
	  startup.  This can then be selected as the main clock source
	  for the SOC.

config SOC_ATMEL_SAMC_XOSC
	bool "External crystal oscillator"
	help
	  Say y to enable the external crystal oscillator at startup.

choice
	prompt "Main clock source"
	help
	  Selects the clock that the main clocks, such as the CPU
	  clock and AHB clock, will be derived from.

config SOC_ATMEL_SAMC_XOSC32K_AS_MAIN
	bool "XOSC32K"
	depends on SOC_ATMEL_SAMC_XOSC32K

config SOC_ATMEL_SAMC_XOSC_AS_MAIN
	bool "XOSC"
	depends on SOC_ATMEL_SAMC_XOSC

config SOC_ATMEL_SAMC_OSC48M_AS_MAIN
	bool "OSC48M"

endchoice

endif # SOC_SERIES_SAMC20 || SOC_SERIES_SAMC21
```

## soc/espressif/esp32c3/Kconfig.defconfig
```kconfig
# Copyright (c) 2023-2025 Espressif Systems (Shanghai) Co., Ltd.
# SPDX-License-Identifier: Apache-2.0

if SOC_SERIES_ESP32C3

config NUM_IRQS
	default 32

config SYS_CLOCK_HW_CYCLES_PER_SEC
	default $(dt_node_int_prop_int, /cpus/cpu@0, clock-frequency)

config MAIN_STACK_SIZE
	default 2048

endif # SOC_SERIES_ESP32C3
```
